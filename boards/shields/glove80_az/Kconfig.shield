## boards/shields/glove80_az/Kconfig.shield
```kconfig
# No whitespace after the comma or in the keyboard name!
config SHIELD_GLOVE80_AZ_DONGLE
    def_bool $(shields_list_contains,glove80_az_dongle)
```

## boards/shields/glove80_azalea/Kconfig.shield
```kconfig
# No whitespace after the comma or in the keyboard name!
config SHIELD_GLOVE80_AZALEA_DONGLE
    def_bool $(shields_list_contains,glove80_azalea_dongle)
```

## config/Kconfig.defconfig
```kconfig
# Copyright (c) 2021 The ZMK Contributors
# SPDX-License-Identifier: MIT

if BOARD_GLOVE80_LH

config ZMK_SPLIT_BLE_ROLE_CENTRAL
    default n

endif # BOARD_GLOVE80_LH || BOARD_GLOVE80_RH
```

## config/glove80_defconfig
```kconfig
# Put configuration options here

CONFIG_ZMK_SPLIT_BLE_ROLE_CENTRAL=n
CONFIG_ZMK_SPLIT_ROLE_CENTRAL=n
```
